## Kconfig.patch.0
```kconfig
--- a/drivers/video/msm/Kconfig
+++ b/drivers/video/msm/Kconfig
@@ -52,6 +52,11 @@ config SEC_DEBUG_MDP
 	---help---
 	  Support for MDP debug
 
+config MDP_DEBUG_FS
+	depends on DEBUG_FS
+	bool "MDP Debug FS"
+	default n	  
+
 choice
 	prompt "MDP HW version"
 	default FB_MSM_MDP22
diff --git a/drivers/video/msm/Makefile b/drivers/video/msm/Makefile
index 3260a04..931db1a 100644
```

## arch/arm/Kconfig.rej
```kconfig
--- arch/arm/Kconfig
+++ arch/arm/Kconfig
@@ -2467,6 +2467,12 @@ config NEON
 	  Say Y to include support code for NEON, the ARMv7 Advanced SIMD
 	  Extension.
 
+config KERNEL_MODE_NEON
+	bool "Support for NEON in kernel mode"
+	depends on NEON && AEABI
+	help
+	  Say Y to include support for NEON in kernel mode.
+
 endmenu
 
 menu "Userspace binary formats"
```

## arch/arm/configs/jactive_att_defconfig
```kconfig
CONFIG_MACH_JACTIVE_ATT=y
CONFIG_MACH_JACTIVE=y
CONFIG_EXTRA_FIRMWARE="audience-es325-fw-jactive_att.bin audience-es325-fw-jactive_att_rev02.bin"
CONFIG_EXTRA_FIRMWARE_DIR="firmware"
# InsideSecure VPN Client
CONFIG_VPNCLIENT_SECURITY=y
CONFIG_FB_MSM_MIPI_RENESAS_TFT_VIDEO_FULL_HD_PT_PANEL=y
CONFIG_DISPLAY_DISABLE_TEST_KEY=y
CONFIG_SUPPORT_SECOND_POWER=y
CONFIG_ESD_ERR_FG_RECOVERY=y
CONFIG_SUPPORT_DISPLAY_OCTA_TFT=y
CONFIG_S5K3H5XA=y
CONFIG_S5K6B2YX=y
CONFIG_CAMERA_SW_I2C_ACT=y
CONFIG_IMX175_EEPROM=y
CONFIG_CFG80211_REG_NOT_UPDATED=y
# CONFIG_FB_MSM_MIPI_SAMSUNG_OCTA_VIDEO_FULL_HD_PT_PANEL is not set
# CONFIG_LCD_VDD3_BY_PMGPIO is not set
# TSP
CONFIG_TOUCHSCREEN_SYNAPTICS_PREVENT_HSYNC_LEAKAGE=y
#
# HALL IC is not supported
CONFIG_SENSORS_HALL=n

#CSVT is not supported
CONFIG_USB_SERIAL_CSVT=n

#CIQ is supported
CONFIG_USB_QCOM_CIQ_BRIDGE=y

CONFIG_SEC_MONITOR_BATTERY_REMOVAL=y

#
# ODE and DIR Encryption
#
CONFIG_CRYPTO=y
CONFIG_CRYPTO_SHA1=y
CONFIG_CRYPTO_SHA256=y
CONFIG_CRYPTO_AES=y
CONFIG_CRYPTO_CBC=y
CONFIG_ECRYPT_FS=y
CONFIG_WTL_ENCRYPTION_FILTER=y
CONFIG_KEYS=y
CONFIG_KEYS_DEBUG_PROC_KEYS=y

# Samsung ODE
CONFIG_FORCE_DISABLE_FIPS=y
```

## arch/arm/configs/jf_att_defconfig
```kconfig
CONFIG_MACH_JF_ATT=y
CONFIG_EXTRA_FIRMWARE="audience-es325-fw.bin"
CONFIG_EXTRA_FIRMWARE_DIR="firmware"
CONFIG_IRDA_MC96=y
# InsideSecure VPN Client
CONFIG_VPNCLIENT_SECURITY=y
CONFIG_CFG80211_REG_NOT_UPDATED=y
CONFIG_SEC_NET_FILTER=y
# SAMP : HOTNESS
CONFIG_SAMP_HOTNESS=y
```

## arch/arm/configs/jf_can_defconfig
```kconfig
CONFIG_MACH_JF_ATT=y
CONFIG_MACH_JF_CAN=y
CONFIG_EXTRA_FIRMWARE="audience-es325-fw-tmo.bin"
CONFIG_EXTRA_FIRMWARE_DIR="firmware"
CONFIG_IRDA_MC96=y
# Samsung ODE
CONFIG_FORCE_DISABLE_FIPS=y

# SAMP : HOTNESS
CONFIG_SAMP_HOTNESS=y
```

## arch/arm/configs/jf_eur_defconfig
```kconfig
CONFIG_MACH_JF_EUR=y
CONFIG_EXTRA_FIRMWARE="audience-es325-fw-eur.bin"
CONFIG_EXTRA_FIRMWARE_DIR="firmware"
CONFIG_CFG80211_REG_NOT_UPDATED=y
CONFIG_CRYPTO_NULL=y
CONFIG_TOUCHSCREEN_ATMEL_MXTS=n

# SSWAP
CONFIG_SWAP=y
CONFIG_FRONTSWAP=y
CONFIG_ZSMALLOC_NEW=y
CONFIG_PGTABLE_MAPPING=y
CONFIG_ZSWAP=y
CONFIG_DIRECT_RECLAIM_FILE_PAGES_ONLY=y
CONFIG_INCREASE_MAXIMUM_SWAPPINESS=y
CONFIG_FIX_INACTIVE_RATIO=y
CONFIG_TIGHT_PGDAT_BALANCE=y
CONFIG_VNSWAP=y
CONFIG_SWAP_ENABLE_READAHEAD=n

# RTCC
CONFIG_ZRAM=n
CONFIG_RUNTIME_COMPCACHE=n

# Samsung ODE
CONFIG_FORCE_DISABLE_FIPS=y

CONFIG_SEC_NET_FILTER=y

# SAMP : HOTNESS
CONFIG_SAMP_HOTNESS=y
```

## arch/arm/configs/jf_rfr_defconfig
```kconfig
CONFIG_MACH_JF_SPR=y
CONFIG_BOARD_JF_REFRESH=y
CONFIG_EXTRA_FIRMWARE="audience-es325-fw.bin"
CONFIG_EXTRA_FIRMWARE_DIR="firmware"
CONFIG_VPNCLIENT_SECURITY=y
```

## arch/arm/configs/jf_spr_defconfig
```kconfig
CONFIG_MACH_JF_SPR=y
CONFIG_EXTRA_FIRMWARE="audience-es325-fw.bin"
CONFIG_EXTRA_FIRMWARE_DIR="firmware"

# InsideSecure VPN Client
CONFIG_VPNCLIENT_SECURITY=y
CONFIG_CFG80211_REG_NOT_UPDATED=y
# Samsung ODE
CONFIG_FORCE_DISABLE_FIPS=y
# SAMP : HOTNESS
CONFIG_SAMP_HOTNESS=y
```

## arch/arm/configs/jf_tmo_defconfig
```kconfig
CONFIG_MACH_JF_TMO=y
CONFIG_EXTRA_FIRMWARE="audience-es325-fw-tmo.bin"
CONFIG_EXTRA_FIRMWARE_DIR="firmware"
# InsideSecure VPN Client
CONFIG_VPNCLIENT_SECURITY=y
#Wifi Region code
CONFIG_WLAN_REGION_CODE=402
CONFIG_CFG80211_REG_NOT_UPDATED=y
```

## arch/arm/configs/jf_usc_defconfig
```kconfig
CONFIG_MACH_JF_USC=y
CONFIG_EXTRA_FIRMWARE="audience-es325-fw.bin"
CONFIG_EXTRA_FIRMWARE_DIR="firmware"
# InsideSecure VPN Client
CONFIG_VPNCLIENT_SECURITY=y
CONFIG_CFG80211_REG_NOT_UPDATED=y
# Samsung ODE
CONFIG_FORCE_DISABLE_FIPS=y
```

## arch/arm/configs/jf_vzw_defconfig
```kconfig
CONFIG_MACH_JF_VZW=y
CONFIG_EXTRA_FIRMWARE="audience-es325-fw-vzw.bin"
CONFIG_EXTRA_FIRMWARE_DIR="firmware"
# InsideSecure VPN Client
CONFIG_VPNCLIENT_SECURITY=y
#VMWARE RELATED
#CONFIG_VMWARE_MVP=y
CONFIG_CFG80211_REG_NOT_UPDATED=y

#EPDG
CONFIG_NET_CORE=y
CONFIG_NET_SCH_PRIO=y
CONFIG_NET_SCHED=y   #depends on CONFIG_NET  which is enabled by default.. coz not seeing in the config file
CONFIG_NET_CLS_BASIC=y # required if basic is being used as a filter. depends on CONFIG_NET_CLS so enabling it by default
CONFIG_NET_CLS=y
CONFIG_NET_CLS_ACT=y # for enabling the action target.
CONFIG_NET_ACT_MIRRED=y  # for enabling the mirred target for redirecting the packet between the devices.
CONFIG_NET_EMATCH=y   #basic uses extended matches so this has to be present
CONFIG_NET_SCH_INGRESS=y # classifier for ingress packet

# USB
CONFIG_USB_RNDIS_VZW_REQ=y

# RTCC
CONFIG_ZRAM=n
CONFIG_RUNTIME_COMPCACHE=n

# SAMP : HOTNESS
CONFIG_SAMP_HOTNESS=y

# SSWAP
CONFIG_SWAP=y
CONFIG_FRONTSWAP=y
CONFIG_ZSMALLOC_NEW=y
CONFIG_PGTABLE_MAPPING=y
CONFIG_ZSWAP=y
CONFIG_DIRECT_RECLAIM_FILE_PAGES_ONLY=y
CONFIG_INCREASE_MAXIMUM_SWAPPINESS=y
CONFIG_FIX_INACTIVE_RATIO=y
CONFIG_TIGHT_PGDAT_BALANCE=y
CONFIG_VNSWAP=y
CONFIG_SWAP_ENABLE_READAHEAD=n
```

## arch/arm/configs/jfve_eur_defconfig
```kconfig
CONFIG_MACH_JFVE_EUR=y
CONFIG_MACH_JFVE_EUR_LTE=y
CONFIG_EXTRA_FIRMWARE="audience-es325-fw-eur.bin"
CONFIG_EXTRA_FIRMWARE_DIR="firmware"

CONFIG_WCNSS_CORE=y
CONFIG_MSM_PIL_RIVA=y
# CONFIG_BCM4335 is not set
# CONFIG_BROADCOM_WIFI_RESERVED_MEM is not set
# CONFIG_WLAN_REGION_CODE is not set
# CONFIG_BCMDHD_FW_PATH is not set
# CONFIG_BCMDHD_NVRAM_PATH is not set
# CONFIG_MMC_MSM_SDC4_SUPPORT is not set
# CONFIG_MMC_MSM_SDC2_SUPPORT is not set
# CONFIG_CFG80211_ALLOW_RECONNECT is not set
CONFIG_MSM_WCNSS_SSR_8960=y
CONFIG_WCNSS_MEM_PRE_ALLOC=y

# Bluetooth feature(Qualcomm)
# CONFIG_BT_BCM4335 is not set

CONFIG_DIAGFWD_REMOTE_PROC_TEMP=y

CONFIG_MHL_VERSION=0x21

# For Fortemedia 2MIC Solution
CONFIG_SND_SOC_ES325=n
CONFIG_SND_SOC_ES325_SLIM=n
```

## arch/arm/configs/msm8930_melius_mtr_defconfig
```kconfig
CONFIG_MACH_MELIUS_MTR=y
CONFIG_MSM_AVS_HW=n
CONFIG_WCNSS_CCX=y
CONFIG_SEC_PERIPHERAL_SECURE_CHK=y
CONFIG_MUIC_AUDIO_OUTPUT_CONTROL=y

# Inside Secure VPN
CONFIG_INSIDESECURE_VPNCLIENT=y

# SSWAP
CONFIG_SWAP=y
CONFIG_FRONTSWAP=y
CONFIG_ZSMALLOC_NEW=y
CONFIG_PGTABLE_MAPPING=y
CONFIG_ZSWAP=y
CONFIG_DIRECT_RECLAIM_FILE_PAGES_ONLY=n
CONFIG_INCREASE_MAXIMUM_SWAPPINESS=y
CONFIG_FIX_INACTIVE_RATIO=y
CONFIG_TIGHT_PGDAT_BALANCE=y
CONFIG_VNSWAP=y
CONFIG_SWAP_ENABLE_READAHEAD=n
#Effective writeback
CONFIG_EXT4_EFFECTIVE_WRITEBACK=y
```

## arch/arm/configs/msm8960_comanche_att_defconfig
```kconfig
#variant defconfig

CONFIG_MACH_COMANCHE_ATT=y
#Inside Secure
CONFIG_INSIDESECURE_VPNCLIENT=y
```

## arch/arm/configs/msm8960_m2_mpcs_defconfig
```kconfig
#m2 mpcs variant defconfig
CONFIG_MACH_M2_VZW=y
CONFIG_MACH_M2_MTR=y

# MIPI Clock setting
CONFIG_MIPI_CLK_500=y

# Battery charging and BMS
# CONFIG_BATTERY_MSM is not set
# CONFIG_PM8921_BMS is not set
CONFIG_PM8XXX_CCADC=y
CONFIG_PM8921_CHARGER=y
CONFIG_PM8921_SEC_CHARGER=y
CONFIG_BATTERY_MAX17040=y
CONFIG_CHARGER_SMB347=y
CONFIG_BATTERY_SEC=y
CONFIG_BATTERY_CTIA=y
CONFIG_WIRELESS_CHARGING=y
CONFIG_SAMSUNG_LPM_MODE=y
CONFIG_BATTERY_BCL=y

CONFIG_MIPI_CLK_500=y
CONFIG_DMUX_LA1_5=y
CONFIG_VZW_VOLUME=y
CONFIG_CFG80211_ALLOW_RECONNECT=y
```

## arch/arm/configs/msm8960_m2_mpcs_eng_defconfig
```kconfig
# CONFIG_IKCONFIG is not set
# CONFIG_IKCONFIG_PROC is not set
CONFIG_KPROBES=y
CONFIG_MSM_RTB=y
CONFIG_MSM_RTB_SEPARATE_CPUS=y
CONFIG_DEBUG_GPIO=y
CONFIG_SAMSUNG_DEBUG_DISPLAY=y
CONFIG_USB_GADGET_DEBUG_FILES=y
CONFIG_MMC_PERF_PROFILING=y
CONFIG_DEBUG_KMEMLEAK=y
CONFIG_DEBUG_KMEMLEAK_DEFAULT_OFF=y
CONFIG_DEBUG_SPINLOCK=y
CONFIG_DEBUG_MUTEXES=y
CONFIG_DEBUG_MEMORY_INIT=y
CONFIG_FAULT_INJECTION=y
CONFIG_FAILSLAB=y
CONFIG_FAIL_PAGE_ALLOC=y
CONFIG_FAULT_INJECTION_DEBUG_FS=y
CONFIG_FAULT_INJECTION_STACKTRACE_FILTER=y
CONFIG_DEBUG_PAGEALLOC=y
CONFIG_DYNAMIC_DEBUG=y
CONFIG_SEC_SSR_DUMP=y
CONFIG_SEC_DEBUG_IRQ_EXIT_LOG=y
CONFIG_DEBUG_ATOMIC_SLEEP=y
CONFIG_DEBUG_STACK_USAGE=y
CONFIG_SEC_GPIO_DVS=y
CONFIG_CPU_FREQ_SWITCH_PROFILER=y
CONFIG_CORESIGHT=y
CONFIG_CORESIGHT_TPIU=y
CONFIG_CORESIGHT_ETB=y
CONFIG_CORESIGHT_FUNNEL=y
CONFIG_CORESIGHT_ETM=y
CONFIG_CORESIGHT_ETM_DEFAULT_ENABLE=y
CONFIG_CORESIGHT_EVENT=m
# CONFIG_SEC_RESTRICT_ROOTING is not set
# CONFIG_SEC_RESTRICT_SETUID is not set
# CONFIG_SEC_RESTRICT_FORK is not set
# CONFIG_SEC_RESTRICT_ROOTING_LOG is not set
#Enabling debug flags
CONFIG_PAGE_GUARD=y
CONFIG_PAGE_POISONING=y
CONFIG_SLUB_DEBUG=y
CONFIG_MACH_M2_MTR=y
```

## arch/arm/configs/msm8960_m2_refreshspr_defconfig
```kconfig
CONFIG_MACH_M2_SPR=y
CONFIG_MACH_M2_REFRESHSPR=y

# MIPI CLock setting
CONFIG_MIPI_CLK_500=y

# Battery charging and BMS
# CONFIG_BATTERY_MSM is not set
# CONFIG_PM8921_BMS is not set
CONFIG_PM8XXX_CCADC=y
CONFIG_PM8921_CHARGER=y
CONFIG_PM8921_SEC_CHARGER=y
CONFIG_BATTERY_MAX17040=y
CONFIG_CHARGER_SMB347=y
CONFIG_BATTERY_SEC=y
CONFIG_BATTERY_CTIA=y
CONFIG_WIRELESS_CHARGING=y
CONFIG_SAMSUNG_LPM_MODE=y
CONFIG_BATTERY_BCL=y
CONFIG_INSIDESECURE_VPNCLIENT=y

CONFIG_SEC_THERMISTOR=y
```

## arch/arm/configs/msm8960_m2_tmo_defconfig
```kconfig
#m2 TMO variant defconfig
CONFIG_MACH_M2_ATT=y

# Battery charging and BMS
# CONFIG_BATTERY_MSM is not set
# CONFIG_PM8921_BMS is not set
CONFIG_PM8XXX_CCADC=y
CONFIG_PM8921_CHARGER=y
CONFIG_PM8921_SEC_CHARGER=y
CONFIG_BATTERY_MAX17040=y
CONFIG_CHARGER_SMB347=y
CONFIG_BATTERY_SEC=y
CONFIG_BATTERY_CTIA=y
CONFIG_WIRELESS_CHARGING=y
CONFIG_SAMSUNG_LPM_MODE=y
CONFIG_BATTERY_BCL=y
CONFIG_INSIDESECURE_VPNCLIENT=y
CONFIG_BRCM_CCX=y
```

## arch/arm/configs/msm8960_m2_vzw_defconfig
```kconfig
#M2 VZW variant defconfig
CONFIG_MACH_M2_VZW=y

#Mipi clock setting
CONFIG_MIPI_CLK_487=y

# Battery charging and BMS
# CONFIG_BATTERY_MSM is not set
# CONFIG_PM8921_BMS is not set
CONFIG_PM8XXX_CCADC=y
CONFIG_PM8921_CHARGER=y
CONFIG_PM8921_SEC_CHARGER=y
CONFIG_BATTERY_MAX17040=y
CONFIG_CHARGER_SMB347=y
CONFIG_BATTERY_SEC=y
CONFIG_BATTERY_CTIA=y
CONFIG_WIRELESS_CHARGING=y
CONFIG_SAMSUNG_LPM_MODE=y
CONFIG_BATTERY_BCL=y

CONFIG_MIPI_CLK_487=y
CONFIG_SEC_PERIPHERAL_SECURE_CHK=y
CONFIG_VZW_VOLUME=y
CONFIG_CFG80211_ALLOW_RECONNECT=y

#VMWARE RELATED
CONFIG_VMWARE_MVP=y

#InsideSecure VPN
CONFIG_INSIDESECURE_VPNCLIENT=y
CONFIG_SEC_THERMISTOR=y
```

## arch/arm/configs/msm8960_m2_xar_defconfig
```kconfig
#M2 XAR variant defconfig
CONFIG_MACH_M2_VZW=y

# MIPI Clock setting
CONFIG_MIPI_CLK_500=y

# Battery charging and BMS
# CONFIG_BATTERY_MSM is not set
# CONFIG_PM8921_BMS is not set
CONFIG_PM8XXX_CCADC=y
CONFIG_PM8921_CHARGER=y
CONFIG_PM8921_SEC_CHARGER=y
CONFIG_BATTERY_MAX17040=y
CONFIG_CHARGER_SMB347=y
CONFIG_BATTERY_SEC=y
CONFIG_BATTERY_CTIA=y
CONFIG_WIRELESS_CHARGING=y
CONFIG_SAMSUNG_LPM_MODE=y
CONFIG_BATTERY_BCL=y

CONFIG_MIPI_CLK_500=y
CONFIG_SEC_PERIPHERAL_SECURE_CHK=y
CONFIG_VZW_VOLUME=y
CONFIG_CFG80211_ALLOW_RECONNECT=y

#
#SELinux Related Changes
#

CONFIG_AUDIT=y
CONFIG_AUDITSYSCALL=y
CONFIG_LSM_MMAP_MIN_ADDR=4096
CONFIG_SECURITY_SELINUX=y
CONFIG_SECURITY_SELINUX_DEVELOP=y
CONFIG_SECURITY_SELINUX_AVC_STATS=y
CONFIG_SECURITY_SELINUX_CHECKREQPROT_VALUE=y
CONFIG_NETWORK_SECMARK=y
CONFIG_NETFILTER_ADVANCED=y
CONFIG_DEFAULT_SECURITY=y
CONFIG_DEFAULT_SECURITY="selinux"
CONFIG_EXT4_FS_XATTR=y
CONFIG_PROC_AVC=y
```

## arch/arm/mach-msm/Kconfig.rej
```kconfig
--- arch/arm/mach-msm/Kconfig
+++ arch/arm/mach-msm/Kconfig
@@ -3277,6 +3281,12 @@ config SEC_FACTORY
 	default n
 	help
 	  Enable Features only For FACTORY BINARY.
+	  
+config HAS_MACH_MEMUTILS
+	default n
+	bool "Motorola MSM memcpy enhancements"
+	help
+	Faster memcpy performance for Krait
 
 config FORCE_FAST_CHARGE
 	bool "Force fast charging (AC/USB) by Yank555.lu"
```

## arch/xtensa/Kconfig.debug
```kconfig
# SPDX-License-Identifier: GPL-2.0
menu "Kernel hacking"

source "lib/Kconfig.debug"

endmenu
```

## drivers/cpu_hotplug/Kconfig
```kconfig
menu "CPU Hotplug"

config LAZYPLUG
	bool "Conservative hotplugging for generic devices"
	default y
	help
	  This enables the conservative hotplugging, lazyplug by arter97
	  based on intelli_plug. Refer to the comments for more info.

config INTELLI_HOTPLUG
        bool "Enable intelli-plug cpu hotplug driver"
        default n
        help
          Generic Intelli-plug cpu hotplug driver for ARM SOCs

config MSM_ZEN_DECISION
        bool "Enable Zen-Decision Core-Wakeup-helper driver"
        default n
        help
          Supplementary driver for MSM based SOCs

config ALUCARD_HOTPLUG
	bool "Enable alucard-hotplug cpu hotplug driver"
	default y
	help
	  Generic Alucard-hotplug cpu hotplug driver for ARM SOCs

config ALUCARD_HOTPLUG_USE_RQ_STATS
	bool "Enable alucard-hotplug msm rq statistics using"
	default n
	help
	  Alucard-hotplug msm rq stats

config BRICKED_HOTPLUG
	bool "Enable kernel based mpdecision"
	default y
	help
	  This enables kernel based multi-core, load-based, hotplug core control.

config MSM_SLEEPER
	bool "CPU hotplug driver"
	default n
	help
	  CPU hotplug driver

config THUNDERPLUG_CONTROL
	bool "Enable plugging down/up of cores based on load per core"
	help
	  This driver hotplugs cpu cores based on per-core load

config BLU_PLUG
	bool "Enable Blu_Plug Hotplug Driver ported from various Nexus Devices"
	help
	  Blu_Plug is an updated verison of the Dynamic Hotplug created by
	  Stratos Karafotis for Mako, and updated by engstk.  Hopefully this
	  won't cause kernel panics like Dyn_Hotplug did.

config FAST_HOTPLUG
	bool "Enable Fast Hotplug"

config MAKO_HOTPLUG
	bool "Enable Mako Hotplug"

config ARM_AUTO_HOTPLUG
	bool "Auto hotplugging based on scheduler runqueue load for ARM SoCs"
	default n

config MSM_HOTPLUG
	bool "MSM hotplug driver"
	depends on HOTPLUG_CPU
	default n
	help
	  The MSM hotplug driver controls on-/offlining of additional cores based
	  on current cpu load.

config AUTOSMP
	bool "Multi-core automatic hotplug support"
	depends on SMP && HOTPLUG_CPU
	help
	  Automatically hotplugs the multiple cpu cores on and off
	  based on cpu load and suspend state

config MX_HOTPLUG
	bool "Select mx_hotplug"
	help
	  A request based hotplug driver.

config USERSPACE_HOTPLUG
	bool "Select userspace hotplug"
	help
	  A very simple, manual userspace hotplug driver.

endmenu
```
