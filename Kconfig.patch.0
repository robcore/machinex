## drivers/cpufreq/Kconfig
```kconfig
menu "CPU Frequency scaling"

config CPU_FREQ
	bool "CPU Frequency scaling"
	default y
	help
	  CPU Frequency scaling allows you to change the clock speed of
	  CPUs on the fly. This is a nice method to save power, because
	  the lower the CPU clock speed, the less power the CPU consumes.

	  Note that this driver doesn't automatically change the CPU
	  clock speed, you need to either enable a dynamic cpufreq governor
	  (see below) after boot, or use a userspace tool.

	  For details, take a look at <file:Documentation/cpu-freq>.

	  If in doubt, say N.

if CPU_FREQ

config CPU_BOOST
	tristate "Event base short term CPU freq boost"
	depends on CPU_FREQ
	help
	  This driver boosts the frequency of one or more CPUs based on
	  various events that might occur in the system. As of now, the
	  events it reacts to are:
	  - Migration of important threads from one CPU to another.

	  If in doubt, say N.


config CPU_FREQ_TABLE
	tristate

config SCHED_FREQ_INPUT
	bool "Scheduler inputs to cpufreq governor"
	depends on SMP && FAIR_GROUP_SCHED
	help
	  This option enables support for scheduler based CPU utilization
	  calculations which may then be used by any cpufreq governor. The
	  scheduler keeps track of "recent" cpu demand of tasks, which can
	  help determine need for changing frequency well in advance of what
	  a governor would have been able to detect on its own.

config CPU_FREQ_STAT
	tristate "CPU frequency translation statistics"
	select CPU_FREQ_TABLE
	default y
	help
	  This driver exports CPU frequency statistics information through sysfs
	  file system.

	  To compile this driver as a module, choose M here: the
	  module will be called cpufreq_stats.

	  If in doubt, say N.

config CPU_FREQ_STAT_DETAILS
	bool "CPU frequency translation statistics details"
	depends on CPU_FREQ_STAT
	help
	  This will show detail CPU frequency translation table in sysfs file
	  system.

	  If in doubt, say N.

choice
	prompt "Default CPUFreq governor"
	default CPU_FREQ_DEFAULT_GOV_USERSPACE if CPU_FREQ_SA1100 || CPU_FREQ_SA1110
	default CPU_FREQ_DEFAULT_GOV_PERFORMANCE
	help
	  This option sets which CPUFreq governor shall be loaded at
	  startup. If in doubt, select 'performance'.

config CPU_FREQ_DEFAULT_GOV_UBERDEMAND
	bool "uberdemand"
	select CPU_FREQ_GOV_UBERDEMAND
	select CPU_FREQ_GOV_PERFORMANCE
	help
	  Use the CPUFreq governor 'ondemand' as default. This allows
	  you to get a full dynamic frequency capable system by simply
	  loading your cpufreq low-level hardware driver.
	  Be aware that not all cpufreq drivers support the ondemand
	  governor. If unsure have a look at the help section of the
	  driver. Fallback governor will be the performance governor.
	  uberdemand has built in a second phase profile.

config CPU_FREQ_DEFAULT_GOV_PERFORMANCE
	bool "performance"
	select CPU_FREQ_GOV_PERFORMANCE
	help
	  Use the CPUFreq governor 'performance' as default. This sets
	  the frequency statically to the highest frequency supported by
	  the CPU.

config CPU_FREQ_DEFAULT_GOV_POWERSAVE
	bool "powersave"
	depends on EXPERT
	select CPU_FREQ_GOV_POWERSAVE
	help
	  Use the CPUFreq governor 'powersave' as default. This sets
	  the frequency statically to the lowest frequency supported by
	  the CPU.

config CPU_FREQ_DEFAULT_GOV_USERSPACE
	bool "userspace"
	select CPU_FREQ_GOV_USERSPACE
	help
	  Use the CPUFreq governor 'userspace' as default. This allows
	  you to set the CPU frequency manually or when a userspace
	  program shall be able to set the CPU dynamically without having
	  to enable the userspace governor manually.

config CPU_FREQ_DEFAULT_GOV_XPERIENCE
	bool "xperience"
	select CPU_FREQ_GOV_XPERIENCE
	help
	Use the CPUFreq governor 'xperience' as default.

config CPU_FREQ_DEFAULT_GOV_ONDEMAND
	bool "ondemand"
	select CPU_FREQ_GOV_ONDEMAND
	select CPU_FREQ_GOV_PERFORMANCE
	help
	  Use the CPUFreq governor 'ondemand' as default. This allows
	  you to get a full dynamic frequency capable system by simply
	  loading your cpufreq low-level hardware driver.
	  Be aware that not all cpufreq drivers support the ondemand
	  governor. If unsure have a look at the help section of the
	  driver. Fallback governor will be the performance governor.

config CPU_FREQ_DEFAULT_GOV_STOCKDEMAND
	bool "stockdemand"
	select CPU_FREQ_GOV_STOCKDEMAND
	select CPU_FREQ_GOV_PERFORMANCE
	help
	  Use the CPUFreq governor 'stockdemand' as default. This allows
	  you to get a full dynamic frequency capable system by simply
	  loading your cpufreq low-level hardware driver.
	  Be aware that not all cpufreq drivers support the ondemand
	  governor. If unsure have a look at the help section of the
	  driver. Fallback governor will be the performance governor.
	  This is default LG ondemand cpu gov.

config CPU_FREQ_DEFAULT_GOV_ELECTROACTIVE
	bool "electroactive"
	select CPU_FREQ_GOV_ELECTROACTIVE
	select CPU_FREQ_GOV_PERFORMANCE
	help
	  Use the CPUFreq governor 'elementalx' as default.

config CPU_FREQ_DEFAULT_GOV_ELECTRODEMAND
	bool "electrodemand"
	select CPU_FREQ_GOV_ELECTRODEMAND
	select CPU_FREQ_GOV_PERFORMANCE
	help
	  Use the CPUFreq governor 'elementalx' as default.

config CPU_FREQ_DEFAULT_GOV_CONSERVATIVE
	bool "conservative"
	select CPU_FREQ_GOV_CONSERVATIVE
	select CPU_FREQ_GOV_PERFORMANCE
	help
	  Use the CPUFreq governor 'conservative' as default. This allows
	  you to get a full dynamic frequency capable system by simply
	  loading your cpufreq low-level hardware driver.
	  Be aware that not all cpufreq drivers support the conservative
	  governor. If unsure have a look at the help section of the
	  driver. Fallback governor will be the performance governor.

config CPU_FREQ_DEFAULT_GOV_INTERACTIVE
	bool "interactive"
	select CPU_FREQ_GOV_INTERACTIVE
	help
	  Use the CPUFreq governor 'interactive' as default. This allows
	  you to get a full dynamic cpu frequency capable system by simply
	  loading your cpufreq low-level hardware driver, using the
	  'interactive' governor for latency-sensitive workloads.

config CPU_FREQ_DEFAULT_GOV_ASSWAX
            bool "asswax"
            select CPU_FREQ_GOV_ASSWAX
            help
              Use the CPUFreq governor 'asswax' as default.

config CPU_FREQ_DEFAULT_GOV_DANCEDANCE
            bool "dancedance"
            select CPU_FREQ_GOV_DANCEDANCE
            help
              Use the CPUFreq governor 'dancedance' as default.

config CPU_FREQ_DEFAULT_GOV_LIONHEART
            bool "lionheart"
            select CPU_FREQ_GOV_LIONHEART
            help
              Use the CPUFreq governor 'lionheart' as default.

config CPU_FREQ_DEFAULT_GOV_SMARTMAX
            bool "smartmax"
            select CPU_FREQ_GOV_SMARTMAX
            help
              Use the CPUFreq governor 'smartmax' as default.

config CPU_FREQ_DEFAULT_GOV_WHEATLEY
	bool "wheatley"
	select CPU_FREQ_GOV_WHEATLEY
	select CPU_FREQ_GOV_PERFORMANCE
	help
	  Use the CPUFreq governor 'wheatley' as default.

config CPU_FREQ_DEFAULT_GOV_CONSERVATIVEX
	bool "conservativex"
	select CPU_FREQ_GOV_CONSERVATIVEX
	help
	  Use the CPUFreq governor 'conservativex' as default.

config CPU_FREQ_DEFAULT_GOV_PEGASUSQ
	bool "pegasusq"
	select CPU_FREQ_GOV_PEGASUSQ
	help
	Use the CPUFreq governor 'pegasusq' as default.

config CPU_FREQ_DEFAULT_GOV_ABYSSPLUGV2
        bool "abyssplugv2"
        select CPU_FREQ_GOV_ABYSSPLUGV2
        ---help---
             Use the CPUFreq governor 'abyssplugv2' as default. This allows you
             to get a full dynamic frequency capable system with CPU
             hotplug support by simply loading your cpufreq low-level
             hardware driver. Be aware that not all cpufreq drivers
             support the hotplug governor. If unsure have a look at
             the help section of the driver. Fallback governor will be the
             performance governor.

config CPU_FREQ_DEFAULT_GOV_INTELLIACTIVE
	bool "intelliactive"
	select CPU_FREQ_GOV_INTELLIACTIVE
	help
	  Use the CPUFreq governor 'intelliactive' as default. This allows
	  you to get a full dynamic cpu frequency capable system by simply
	  loading your cpufreq low-level hardware driver, using the
	  'interactive' governor for latency-sensitive workloads.

config CPU_FREQ_DEFAULT_GOV_ONDEMANDPLUS
	bool "ondemandplus"
	select CPU_FREQ_GOV_ONDEMANDPLUS
	---help---
  	     Use the CPUFreq governor 'ondemandplus' as default. This allows
	     you to get a full dynamic frequency capable system by simply
	     loading your cpufreq low-level hardware driver.
	     Be aware that not all cpufreq drivers support the ondemandplus
	     governor. If unsure have a look at the help section of the
	     driver. Fallback governor will be the performance governor.

config CPU_FREQ_DEFAULT_GOV_NIGHTMARE
	bool "nightmare"
	select CPU_FREQ_GOV_NIGHTMARE
	help

config CPU_FREQ_DEFAULT_GOV_DARKNESS
	bool "darkness"
  	select CPU_FREQ_GOV_DARKNESS
  	help

config CPU_FREQ_DEFAULT_GOV_ALUCARD
  	bool "alucard"
  	select CPU_FREQ_GOV_ALUCARD
  	help

config CPU_FREQ_DEFAULT_GOV_INTELLIDEMAND
	bool "intellidemand"
	select CPU_FREQ_GOV_INTELLIDEMAND
	help
	  Use the CPUFreq governor 'intellidemand' as default. This is
	  based on Ondemand with browsing detection based on GPU loading

config CPU_FREQ_DEFAULT_GOV_YANKACTIVE
 	   bool "yankactive"
  	   select CPU_FREQ_GOV_YANKACTIVE
	   help
	   Use the CPUFreq governor 'yankactive' as default. This allows
	   you to get a full dynamic cpu frequency capable system by simply
	   loading your cpufreq low-level hardware driver, using the
	   'yankactive' governor for latency-sensitive workloads.

config CPU_FREQ_DEFAULT_GOV_YANKDEMAND
 	   bool "yankactive"
  	   select CPU_FREQ_GOV_YANKDEMAND
	   help
	   Use the CPUFreq governor 'yankdemand' as default. This allows
	   you to get a full dynamic cpu frequency capable system by simply
	   loading your cpufreq low-level hardware driver, using the
	   'yankdemand' governor for latency-sensitive workloads.

config CPU_FREQ_DEFAULT_GOV_UMBRELLA_CORE
	bool "umbrella_core"
	select CPU_FREQ_GOV_UMBRELLA_CORE
	help
	  Use the CPUFreq governor 'umbrella_core' as default. This allows
	  you to get a full dynamic cpu frequency capable system by simply
	  loading your cpufreq low-level hardware driver, using the
	  'umbrella_core' governor for latency-sensitive workloads.

config CPU_FREQ_DEFAULT_GOV_DYNAMIC_INTERACTIVE
	bool "dynamic_interactive"
	select CPU_FREQ_GOV_DYNAMIC_INTERACTIVE

config CPU_FREQ_DEFAULT_GOV_BLU_ACTIVE
	bool "bluactive"
	select CPU_FREQ_GOV_BLU_ACTIVE
	help
	Use the CPUFreq governor 'blu_active' as default.

config CPU_FREQ_DEFAULT_GOV_HYPERX
	bool "hyperx"
	select CPU_FREQ_GOV_HYPERX
	help
	Use the CPUfreq governor 'hyperx' as default.

config CPU_FREQ_DEFAULT_GOV_BIOSHOCK
	bool "BioShock"
	select CPU_FREQ_GOV_BIOSHOCK
	help
	  Default governor of BioShock kernel

config CPU_FREQ_DEFAULT_GOV_INTERACTIVE_PRO
	bool "interactive_pro"
	select CPU_FREQ_GOV_INTERACTIVE_PRO
	help
	Use the CPUFreq governor 'interactive_pro' as default.

config CPU_FREQ_DEFAULT_GOV_INTELLIDEMAND
	bool "intellidemand"
	select CPU_FREQ_GOV_INTELLIDEMAND
	help
	  Use the CPUFreq governor 'intellidemand' as default. This is
	  based on Ondemand with browsing detection based on GPU loading

config CPU_FREQ_DEFAULT_GOV_ZZMOOVE
	bool "zzmoove"
	select CPU_FREQ_GOV_ZZMOOVE
	help

config CPU_FREQ_DEFAULT_GOV_LULZACTIVE
	bool "lulzactive"
	select CPU_FREQ_GOV_LULZACTIVE
	help

config CPU_FREQ_DEFAULT_GOV_IMPULSE
	bool "impulse"
	select CPU_FREQ_GOV_IMPULSE
	help
	  Use the CPUFreq governor 'impulse' as default.

config CPU_FREQ_DEFAULT_GOV_OPTIMAX
 	bool "optimax"
 	select CPU_FREQ_GOV_OPTIMAX
 	select CPU_FREQ_GOV_PERFORMANCE
 	help
 	  Use the CPUFreq governor 'optimax' as default

config CPU_FREQ_DEFAULT_GOV_IRONACTIVE
	bool "ironactive"
	depends on SCHED_FREQ_INPUT
	select CPU_FREQ_GOV_IRONACTIVE
	help
	  Use the CPUFreq governor 'ironactive' as default. This cpugovernor
	  is based on the 'interactive' governor with many changes made by
	  CAF.

config CPU_FREQ_DEFAULT_GOV_SMARTMAX_EPS
	bool "smartmax_eps"
	select CPU_FREQ_GOV_SMARTMAX_EPS
	help
	  Use the CPUFreq governor 'smartmax eps' as default

config CPU_FREQ_DEFAULT_GOV_PRESERVATIVE
	bool "preservative"
	select CPU_FREQ_GOV_PRESERVATIVE
	select CPU_FREQ_GOV_PERFORMANCE
	help
	 Use the CPUFreq governor 'preservative' as default.

config CPU_FREQ_DEFAULT_GOV_LIGHTNING
 	bool "lightning"
 	select CPU_FREQ_GOV_LIGHTNING

config CPU_FREQ_DEFAULT_GOV_LIONFISH
	bool "lionfish"
	select CPU_FREQ_GOV_LIONFISH
	help
	  Use the CPUFreq governor 'lionfish' as default.

config CPU_FREQ_DEFAULT_GOV_WAVE
	bool "wave"
	select CPU_FREQ_GOV_WAVE
	help
	 Use the CPUFreq governor 'wave' as default

config CPU_FREQ_DEFAULT_GOV_MYTHX_PLUG
	bool "mythx_plug"
	select CPU_FREQ_GOV_MYTHX_PLUG
	help

config CPU_FREQ_DEFAULT_GOV_CAFACTIVE
	bool "cafactive"
	select CPU_FREQ_GOV_CAFACTIVE
	help
	  Use the CPUFreq governor 'cafactive' as default. This allows
	  you to get a full dynamic cpu frequency capable system by simply
	  loading your cpufreq low-level hardware driver, using the
	  'cafactive' governor for latency-sensitive workloads.

config CPU_FREQ_DEFAULT_GOV_BARRY_ALLEN
	bool "barry_allen"
	select CPU_FREQ_GOV_BARRY_ALLEN
	help
	  Use the CPUFreq governor 'barry_allen' as default. This allows
	  you to get a full dynamic cpu frequency capable system by simply
	  loading your cpufreq low-level hardware driver, using the
	  'barry_allen' governor for latency-sensitive workloads.

config CPU_FREQ_DEFAULT_GOV_SMARTASSH3
	bool "smartassH3"
	select CPU_FREQ_GOV_SMARTASSH3
 	help
	  Use the CPUFreq governor 'smartassH3' as default.

config CPU_FREQ_DEFAULT_GOV_MEDUSA
	bool "medusa"
	select CPU_FREQ_GOV_MEDUSA
	help
	  Use 'medusa' governor as default.

config CPU_FREQ_DEFAULT_GOV_BACON
	bool "bacon"
	select CPU_FREQ_GOV_BACON
	help
	  Use the CPUFreq governor 'bacon' as default. This allows
	  you to get a full dynamic cpu frequency capable system by simply
	  loading your cpufreq low-level hardware driver, using the
	  'bacon' governor for latency-sensitive workloads.

config CPU_FREQ_DEFAULT_GOV_ONDEMAND_X
	bool "ondemand_x"
	select CPU_FREQ_GOV_ONDEMAND_X
	select CPU_FREQ_GOV_PERFORMANCE
	help
	  Use the CPUFreq governor 'ondemand_x' as default. This allows
	  you to get a full dynamic frequency capable system by simply
	  loading your cpufreq low-level hardware driver.
	  Be aware that not all cpufreq drivers support the ondemand_x
	  governor. If unsure have a look at the help section of the
	  driver. Fallback governor will be the performance governor.

config CPU_FREQ_DEFAULT_GOV_HYPER
	bool "HYPER"
	select CPU_FREQ_GOV_HYPER
	---help---
	  Use the CPUFreq governor 'HYPER' as default.

config CPU_FREQ_DEFAULT_GOV_DESPAIR
	bool "despair"
	select CPU_FREQ_GOV_DESPAIR
	help

config CPU_FREQ_DEFAULT_GOV_HELLSACTIVE
	bool "hellsactive"
	select CPU_FREQ_GOV_HELLSACTIVE
	help
	  Use the CPUFreq governor 'hellsactive' as default. This allows
	  you to get a full dynamic cpu frequency capable system by simply
	  loading your cpufreq low-level hardware driver, using the
	  'interactive' governor for latency-sensitive workloads.

config CPU_FREQ_DEFAULT_GOV_RAGINGMOLASSES
	bool "ragingmolasses"
	select CPU_FREQ_GOV_RAGINMOLASSES
	help
	  Use the CPUFreq governor 'ragingmolasses' as default.
          Work in progress attempt at a goodaround governor that can do either high performance or battery.
          Attempts to keep CPU away from max frequ ency as much as possible.

config CPU_FREQ_DEFAULT_GOV_ARTERACTIVE
	bool "hellsactive"
	select CPU_FREQ_GOV_ARTERACTIVE
	help
	  Use the CPUFreq governor 'arteractive' as default. This allows
	  you to get a full dynamic cpu frequency capable system by simply
	  loading your cpufreq low-level hardware driver, using the
	  'interactive' governor for latency-sensitive workloads.

config CPU_FREQ_DEFAULT_GOV_INTERACTIVE_X
	bool "interactive_x"
	select CPU_FREQ_GOV_INTERACTIVE_X
	help
	  Use the CPUFreq governor 'interactive_x' as default. This allows
	  you to get a full dynamic cpu frequency capable system by simply
	  loading your cpufreq low-level hardware driver, using the
	  'interactive' governor for latency-sensitive workloads.

config CPU_FREQ_DEFAULT_GOV_CONSERVATIVE_X
	bool "conservative_x"
	select CPU_FREQ_GOV_CONSERVATIVE_X
	select CPU_FREQ_GOV_PERFORMANCE
	help
	  Use the CPUFreq governor 'conservative_x' as default. This allows
	  you to get a full dynamic frequency capable system by simply
	  loading your cpufreq low-level hardware driver.
	  Be aware that not all cpufreq drivers support the conservative
	  governor. If unsure have a look at the help section of the
	  driver. Fallback governor will be the performance governor.

endchoice

config CPU_FREQ_GOV_UBERDEMAND
	tristate "'uberdemand' cpufreq policy governor"
	select CPU_FREQ_TABLE
	help
	  'uberdemand' - This driver adds a dynamic cpufreq policy governor.
	  The governor does a periodic polling and
	  changes frequency based on the CPU utilization.
	  The support for this governor depends on CPU capability to
	  do fast frequency switching (i.e, very low latency frequency
	  transitions).

config CPU_FREQ_GOV_UBERDEMAND_SECOND_PHASE_FREQ
        int "Second Phase Uberdemand Frequency"
        default 1674000
        depends on CPU_FREQ_GOV_UBERDEMAND

config CPU_FREQ_GOV_PERFORMANCE
	tristate "'performance' governor"
	help
	  This cpufreq governor sets the frequency statically to the
	  highest available CPU frequency.

	  To compile this driver as a module, choose M here: the
	  module will be called cpufreq_performance.

	  If in doubt, say Y.

config CPU_FREQ_GOV_POWERSAVE
	tristate "'powersave' governor"
	help
	  This cpufreq governor sets the frequency statically to the
	  lowest available CPU frequency.

	  To compile this driver as a module, choose M here: the
	  module will be called cpufreq_powersave.

	  If in doubt, say Y.

config CPU_FREQ_GOV_USERSPACE
	tristate "'userspace' governor for userspace frequency scaling"
	help
	  Enable this cpufreq governor when you either want to set the
	  CPU frequency manually or when a userspace program shall
	  be able to set the CPU dynamically, like on LART
	  <http://www.lartmaker.nl/>.

	  To compile this driver as a module, choose M here: the
	  module will be called cpufreq_userspace.

	  For details, take a look at <file:Documentation/cpu-freq/>.

	  If in doubt, say Y.

config CPU_FREQ_GOV_ONDEMAND
	tristate "'ondemand' cpufreq policy governor"
	select CPU_FREQ_TABLE
	help
	  'ondemand' - This driver adds a dynamic cpufreq policy governor.
	  The governor does a periodic polling and
	  changes frequency based on the CPU utilization.
	  The support for this governor depends on CPU capability to
	  do fast frequency switching (i.e, very low latency frequency
	  transitions).

	  To compile this driver as a module, choose M here: the
	  module will be called cpufreq_ondemand.

	  For details, take a look at linux/Documentation/cpu-freq.

	  If in doubt, say N.

config CPU_FREQ_GOV_STOCKDEMAND
	tristate "'stockdemand' cpufreq policy governor"
	select CPU_FREQ_TABLE
	help
	  hopefully less aggressive than my ondemand, stolen from dorimanx.

config CPU_FREQ_GOV_ELEMENTALX
	tristate "'elementalx' cpufreq policy governor"
	select CPU_FREQ_TABLE
	help
	  'elementalx' - This driver adds a dynamic cpufreq policy governor.

	  To compile this driver as a module, choose M here: the
	  module will be called cpufreq_elementalx.

	  For details, take a look at linux/Documentation/cpu-freq.

	  If in doubt, say N.

config CPU_FREQ_GOV_ELECTROACTIVE
	tristate "'electroactive' cpufreq policy governor"
	select CPU_FREQ_TABLE
	help
	  'electroactive' - This driver adds a dynamic cpufreq policy governor.

config CPU_FREQ_GOV_ELECTRODEMAND
	tristate "'electrodemand' cpufreq policy governor"
	select CPU_FREQ_TABLE
	help
	  'electrodemand' - This driver adds a dynamic, demand-based cpufreq policy governor.

config CPU_FREQ_GOV_INTERACTIVE
	tristate "'interactive' cpufreq policy governor"
	help
	  'interactive' - This driver adds a dynamic cpufreq policy governor
	  designed for latency-sensitive workloads.

	  This governor attempts to reduce the latency of clock
	  increases so that the system is more responsive to
	  interactive workloads.

	  To compile this driver as a module, choose M here: the
	  module will be called cpufreq_interactive.

	  For details, take a look at linux/Documentation/cpu-freq.

	  If in doubt, say N.

config CPU_FREQ_GOV_CONSERVATIVE
	tristate "'conservative' cpufreq governor"
	depends on CPU_FREQ
	help
	  'conservative' - this driver is rather similar to the 'ondemand'
	  governor both in its source code and its purpose, the difference is
	  its optimisation for better suitability in a battery powered
	  environment.  The frequency is gracefully increased and decreased
	  rather than jumping to 100% when speed is required.

	  If you have a desktop machine then you should really be considering
	  the 'ondemand' governor instead, however if you are using a laptop,
	  PDA or even an AMD64 based computer (due to the unacceptable
	  step-by-step latency issues between the minimum and maximum frequency
	  transitions in the CPU) you will probably want to use this governor.

	  To compile this driver as a module, choose M here: the
	  module will be called cpufreq_conservative.

	  For details, take a look at linux/Documentation/cpu-freq.

	  If in doubt, say N.

config CPU_FREQ_GOV_ASSWAX
           tristate "'asswax' cpufreq governor"
           depends on CPU_FREQ
           help
             'asswax' - a "smart" optimized governor!
             If in doubt, say N.

config CPU_FREQ_GOV_DANCEDANCE
           tristate "'dancedance' cpufreq governor"
           depends on CPU_FREQ
           help
             'dancedance' - a "smart" optimized governor!
             If in doubt, say N.

config CPU_FREQ_GOV_LIONHEART
           tristate "'lionheart' cpufreq governor"
           depends on CPU_FREQ
           help
             'lionheart' - the "heart" of this kernel
             If in doubt, say N.

config CPU_FREQ_GOV_YANKACTIVE
	  tristate "'yankactive' cpufreq policy governor"
	  help
	  'yankactive' - This driver adds a dynamic cpufreq policy governor
	  designed for latency-sensitive workloads.
	  The governor is based on interactive with just different default settings
	  and can be achieved using interactive with a script. This is added for
	  simplification purposes for myself.

config CPU_FREQ_GOV_YANKDEMAND
	  tristate "'yankdemand' cpufreq policy governor"
	  help
	  'yankdemand' - This driver adds a dynamic cpufreq policy governor
	  designed for latency-sensitive workloads.
	  The governor is based on ondemand with just different default settings
	  and can be achieved using ondemand with a script. This is added for
	  simplification purposes for myself.

config CPU_FREQ_GOV_SMARTMAX
           tristate "'smartmax' cpufreq governor"
           depends on CPU_FREQ
           help
             smartmax' - combined ondemand and smartass2
             If in doubt, say N.

config CPU_FREQ_GOV_CONSERVATIVEX
	tristate "'conservativex' cpufreq governor"
	depends on CPU_FREQ
	help
	  'conservativex' - less aggressive version of conservative

config CPU_FREQ_GOV_PEGASUSQ
	tristate "'pegasusq' cpufreq policy governor"

config CPU_FREQ_GOV_ABYSSPLUGV2
        tristate "'abyssplugv2' cpufreq governor"
        depends on CPU_FREQ && NO_HZ && HOTPLUG_CPU
        ---help---
         'abyssplugv2' - this driver mimics the frequency scaling behavior
         in 'ondemand', but with several key differences. First is
         that frequency transitions use the CPUFreq table directly,
         instead of incrementing in a percentage of the maximum
         available frequency. Second 'abyssplug' will offline auxillary
         CPUs when the system is idle, and online those CPUs once the
         system becomes busy again. This last feature is needed for
         architectures which transition to low power states when only
         the "master" CPU is online, or for thermally constrained
         devices.
         If you don't have one of these architectures or devices, use
         'ondemand' instead.

         If in doubt, say N.

config CPU_FREQ_GOV_DYNAMIC_INTERACTIVE
	tristate "'dynamic_interactive' cpufreq governor"
	depends on CPU_FREQ

config CPU_FREQ_GOV_LULZACTIVE
	tristate "'lulzactive' cpufreq governor"
	depends on CPU_FREQ

config CPU_FREQ_GOV_HYPERX
	tristate "'hyperx' cpufreq governor"
	depends on CPU_FREQ

config CPU_FREQ_GOV_BLU_ACTIVE
	tristate "'blu_active' cpufreq governor"
	depends on CPU_FREQ
	help
	  'blu_active' - less aggressive version of conservative

	  This governor attempts to reduce the latency of clock
	  increases so that the system is more responsive to
	  interactive workloads.

	  To compile this driver as a module, choose M here: the
	  module will be called cpufreq_interactive.

	  For details, take a look at linux/Documentation/cpu-freq.

	  If in doubt, say N.

config CPU_FREQ_GOV_ONDEMANDPLUS
	tristate "'ondemandplus' cpufreq policy governor"
	depends on CPU_FREQ
	---help---
	 'ondemandplus' - This driver adds a dynamic cpufreq policy
	 governor. The governor does a periodic polling and
	 changes frequency based on the CPU utilization.
	 The support for this governor depends on CPU capability to
	 do fast frequency switching (i.e, very low latency frequency
	 transitions).

	 To compile this driver as a module, choose M here: the
	 module will be called cpufreq_ondemandplus.

	 For details, take a look at linux/Documentation/cpu-freq.

	 If in doubt, say N.

config CPU_FREQ_GOV_INTELLIACTIVE
	tristate "'intelliactive' cpufreq policy governor"
	help
	  'intelliactive' - This driver adds a dynamic cpufreq policy
		  governor designed for latency-sensitive workloads.

	  This governor attempts to reduce the latency of clock
	  increases so that the system is more responsive to
	  interactive workloads.

	  To compile this driver as a module, choose M here: the
	  module will be called cpufreq_interactive.

	  For details, take a look at linux/Documentation/cpu-freq.

	  If in doubt, say N.

config CPU_FREQ_GOV_INTERACTIVE_PRO
	tristate "'interactive_pro' cpufreq governor"
	depends on SCHED_FREQ_INPUT
	depends on CPU_FREQ

config CPU_FREQ_GOV_WHEATLEY
	 tristate "'wheatley' cpufreq governor"
	 depends on CPU_FREQ

config CPU_FREQ_GOV_NIGHTMARE
	tristate "'nightmare' cpufreq governor"
	depends on CPU_FREQ

config CPU_FREQ_GOV_DARKNESS
	tristate "'darkness' cpufreq governor"
	depends on CPU_FREQ

config CPU_FREQ_GOV_ALUCARD
	tristate "'alucard' cpufreq governor"
	depends on CPU_FREQ

config CPU_FREQ_GOV_ZZMOOVE
	tristate "'zzmoove' cpufreq governor"
	depends on CPU_FREQ

config CPU_FREQ_GOV_INTERACTIVE_PRO
	tristate "'interactive_pro' cpufreq governor"
	depends on CPU_FREQ

config CPU_FREQ_GOV_BIOSHOCK
	tristate "'bioshock' cpufreq bioshock"
	depends on CPU_FREQ
	help
	  'bioshock' - More aggressive version of conservative

config CPU_FREQ_GOV_LIGHTNING
 	tristate "'lightning' cpufreq governor"
        depends on CPU_FREQ
        ---help---
          'LIGHTNING' - a tweaked "ondemand" based smart and smooth optimized governor!

config CPU_FREQ_GOV_LIONFISH
	tristate "'lionfish' governor"
	depends on CPU_FREQ
	help
	  'lionfish' - this is an improved version of the conservative governor
	  that is optimized for smartphones. To avoid lag, it quickly jumps
	  to an intermediate frequency when high load is encountered at low
	  frequencies. If very high load is encountered above this intermediate
	  frequency, it jumps to a high frequency. For moderate loads, it
	  votes to increase, decrease, or maintain frequencies at each sampling
	  interval. When enough votes are gathered to raise or lower the
	  frequency, the frequency is changed. This mechanism reduces jitter
	  compared to the conservative governor. Lionfish uses proportional
	  ramping to more quickly reach suitable frequencies compared to the
	  conservative governor. By default, Lionfish also reduces frequencies
	  more aggressively than the conservative governor when loads are reduced.

	  To compile this driver as a module, choose M here: the
	  module will be called cpufreq_lionfish.

	  If in doubt, say N.

config CPU_FREQ_GOV_IMPULSE
	tristate "'impulse' cpufreq policy governor"
	help
	  'impulse' - This driver adds a dynamic cpufreq policy governor
	  designed for optimized balance between power and performance.

	  If in doubt, say N.

config CPU_FREQ_GOV_OPTIMAX
	tristate "'optimax' cpufreq policy governor"
	depends on CPU_FREQ

config CPU_FREQ_GOV_PRESERVATIVE
	tristate "'preservative' cpufreq governor"
	depends on CPU_FREQ

config CPU_FREQ_GOV_WAVE
	tristate "'wave' cpufreq governor"
	depends on CPU_FREQ
	help
	'wave' - A conservative based governor
	If in doubt, say N.

config CPU_FREQ_GOV_MYTHX_PLUG
	tristate "'mythx_plug' cpufreq governor"
	depends on CPU_FREQ

config CPU_FREQ_GOV_BARRY_ALLEN
	tristate "'barry_allen' cpufreq policy governor"
	help
	  'barry_allen' - This driver adds a dynamic cpufreq policy governor
	  designed for latency-sensitive workloads.

	  This governor attempts to reduce the latency of clock
	  increases so that the system is more responsive to
	  barry_allen workloads.

	  To compile this driver as a module, choose M here: the
	  module will be called cpufreq_barry_allen.

	  For details, take a look at linux/Documentation/cpu-freq.

	  If in doubt, say N.

config CPU_FREQ_GOV_IRONACTIVE
	tristate "'ironactive' cpufreq policy governor"
	depends on SCHED_FREQ_INPUT
	help
	  'ironactive' - This driver adds a dynamic cpufreq policy governor

	  This governor attempts to reduce the latency of clock
	  increases so that the system is more responsive to
	  ironactive workloads. Based on 'interactive' governor
	  with many changes compared to our stock 'interactive'
	  governor we have from samsung. Mainly CAF changes.

	  To compile this driver as a module, choose M here: the
	  module will be called cpufreq_ironactive.

	  If in doubt, say N.

config CPU_FREQ_GOV_RAGINGMOLASSES
	tristate "'RAGINGMOLASSES' cpufreq policy governor"
	help
	  'RAGINGMOLASSES' - This driver adds a cpufreq policy governor
	  much along the lines of ondemand but tries to keep to low
	  frequencies without hurting performance for workloads that need it.
	  To compile this driver as a module, choose M here: the
	  module will be called cpufreq_interactive.

	  For details, take a look at linux/Documentation/cpu-freq.

	  If in doubt, say N0.

config CPU_FREQ_GOV_SMARTMAX_EPS
	tristate "'smartmax EPS' cpufreq policy governor"
	select CPU_FREQ_TABLE
	help
	  'smartmax EPS' is the extreme powersaving version of smartmax

config CPU_FREQ_GOV_CAFACTIVE
	tristate "'cafactive' cpufreq policy governor"
	help
	  'cafactive' - CodeAurora(Qualcomm) version of interactive
	  cpufreq policy governor.

	  To compile this driver as a module, choose M here: the
	  module will be called cpufreq_cafactive.

	  If in doubt, say N.

config CPU_FREQ_GOV_ONDEMAND_X
	tristate "'ondemand_x' cpufreq policy governor"
	select CPU_FREQ_TABLE
	help
	  'ondemand_x' - This driver adds a dynamic cpufreq policy governor.
	  The governor does a periodic polling and
	  changes frequency based on the CPU utilization.
	  The support for this governor depends on CPU capability to
	  do fast frequency switching (i.e, very low latency frequency
	  transitions).

	  To compile this driver as a module, choose M here: the
	  module will be called cpufreq_ondemand_x.

	  For details, take a look at linux/Documentation/cpu-freq.

	  If in doubt, say N.

config CPU_FREQ_GOV_SMARTASSH3
	tristate "'smartassH3' cpufreq governor"
 	depends on CPU_FREQ
 	help
	  'smartassH3' - a "smart" governor

config SEC_DVFS
	bool "DVFS job"
	default n
	depends on CPU_FREQ

config CPU_FREQ_GOV_HYPER
	tristate "'HYPER' cpufreq governor"
	depends on CPU_FREQ
	---help---
	  'HYPER' - a tweaked "ondemand" based smart and smooth optimized governor!

	  If in doubt, say Y

config CPU_FREQ_GOV_TRIPNDROID
        tristate "'tripndroid' cpufreq governor"

config CPU_FREQ_GOV_INTELLIDEMAND
        tristate "'intellidemand' cpufreq policy governor"
        select CPU_FREQ_TABLE
        help
          'intellidemand' - This driver adds a dynamic cpufreq policy governor.
          The governor does a periodic polling and
          changes frequency based on the CPU utilization.
          The support for this governor depends on CPU capability to
          do fast frequency switching (i.e, very low latency frequency
          transitions). with browsing detection based on GPU loading

          To compile this driver as a module, choose M here: the
          module will be called cpufreq_ondemand.

          For details, take a look at linux/Documentation/cpu-freq.

          If in doubt, say N.

config INTELLI_MAX_ACTIVE_FREQ
	int "Max Active Freq for Intellidemand"
	depends on CPU_FREQ_GOV_INTELLIDEMAND
	default	1890000
	help
		Set default max active frequency for intellidemand

config INTELLI_MAX_INACTIVE_FREQ
	int "Max Inactive Freq for Intellidemand"
	depends on CPU_FREQ_GOV_INTELLIDEMAND
	default	810000
	help
		Set default max inactive frequency for intellidemand

config CPUFREQ_LIMIT_MAX_FREQ
	bool "Limit Max Freq"
	depends on CPU_FREQ_GOV_INTELLIDEMAND
	help
		Limit Max Freq while screen is on for Intellidemand governor

config CPU_FREQ_GOV_DESPAIR
	tristate "'despair' cpufreq governor"
	depends on CPU_FREQ

config CPU_FREQ_GOV_YANKACTIVE
	  tristate "'yankactive' cpufreq policy governor"
	  help
	  'yankactive' - This driver adds a dynamic cpufreq policy governor
	  designed for latency-sensitive workloads.
	  The governor is based on interactive with just different default settings
	  and can be achieved using interactive with a script. This is added for
	  simplification purposes for myself.

config CPU_FREQ_GOV_UMBRELLA_CORE
	tristate "'umbrella_core' cpufreq policy governor"
	help
	  'umbrella_core' - This driver adds a dynamic cpufreq policy governor
	  designed for latency-sensitive workloads.

	  The governor is based on interactive to provide a resident controller
	  which interprets unnecessary battery drain as evil.

config CPU_FREQ_GOV_BLUACTIVE
	tristate "'bluactive' cpufreq governor"
	depends on CPU_FREQ
	help
	  'bluactive' - less aggressive version of conservative

config CPU_FREQ_GOV_MEDUSA
	tristate "'medusa' cpufreq governor"
	help
	  'medusa'is a Linux CPU frequency governor designed for
	  mobile multi-core applications processors
	  (e.g. ARM Cortex and Qualcomm Krait).

	  Feeling risky, say Y.

config CPU_FREQ_GOV_BACON
	tristate "'bacon' cpufreq policy governor"
	help
	  'bacon' - This driver adds a dynamic cpufreq policy governor
	  designed for latency-sensitive workloads.

	  This governor attempts to reduce the latency of clock
	  increases so that the system is more responsive to
	  interactive workloads.

	  To compile this driver as a module, choose M here: the
	  module will be called cpufreq_bacon.

	  For details, take a look at linux/Documentation/cpu-freq.

	  If in doubt, say N.

config CPU_FREQ_GOV_INTERACTIVE_X
	tristate "'interactive_x' cpufreq policy governor"
	help
	  'interactive_x' - This driver adds a dynamic cpufreq policy governor
	  designed for latency-sensitive workloads.

	  This governor attempts to reduce the latency of clock
	  increases so that the system is more responsive to
	  interactive workloads.

	  To compile this driver as a module, choose M here: the
	  module will be called cpufreq_interactive.

	  For details, take a look at linux/Documentation/cpu-freq.

	  If in doubt, say N.

config CPU_FREQ_GOV_CONSERVATIVE_X
	tristate "'conservative_x' cpufreq governor"
	depends on CPU_FREQ
	help
	  'conservative_x' - this driver is rather similar to the 'ondemand'
	  governor both in its source code and its purpose, the difference is
	  its optimisation for better suitability in a battery powered
	  environment.  The frequency is gracefully increased and decreased
	  rather than jumping to 100% when speed is required.

	  If you have a desktop machine then you should really be considering
	  the 'ondemand' governor instead, however if you are using a laptop,
	  PDA or even an AMD64 based computer (due to the unacceptable
	  step-by-step latency issues between the minimum and maximum frequency
	  transitions in the CPU) you will probably want to use this governor.

	  To compile this driver as a module, choose M here: the
	  module will be called cpufreq_conservative.

	  For details, take a look at linux/Documentation/cpu-freq.

	  If in doubt, say N.

config CPU_FREQ_GOV_HELLSACTIVE
	tristate "'hellsactive' cpufreq policy governor"
	help
	  'hellsactive' - This driver adds a dynamic cpufreq policy governor
	  designed for latency-sensitive workloads.

	  This governor attempts to reduce the latency of clock
	  increases so that the system is more responsive to
	  interactive workloads.

	  To compile this driver as a module, choose M here: the
	  module will be called cpufreq_hellsactive.

	  For details, take a look at linux/Documentation/cpu-freq.

	  If in doubt, say N.

config CPU_FREQ_GOV_ARTERACTIVE
	tristate "'arteractive' cpufreq policy governor"
	help
	  'arteractive' - This driver adds a dynamic cpufreq policy governor
	  designed for latency-sensitive workloads.

	  This is an interactive governor built by arter97 with snapdragon
	  chipsets in mind.

	  If in doubt, say N.

config SEC_DVFS
	bool "DVFS job"
	default n
	depends on CPU_FREQ

config CPUFREQ_HARDLIMIT
	bool "CPU Frequency hardlimit driver (Yank555.lu)"
	default y
	depends on CPU_FREQ
	help
	  Enforce CPU scaling min/max against interference by userspace, allow
	  for screen on/off settings for scaling min/max and introducing
	  wakeup kick to reduce wakeup lag (Yank555.lu)

config CPUFREQ_HARDLIMIT_DEBUG
	bool "CPU Frequency hardlimit driver debugging code"
	depends on CPUFREQ_HARDLIMIT
	help
	  Output debugging info in dmesg [HARDLIMIT] (Yank555.lu)

config GENERIC_CPUFREQ_CPU0
	bool "Generic CPU0 cpufreq driver"
	depends on HAVE_CLK && REGULATOR && PM_OPP && OF
	select CPU_FREQ_TABLE
	help
	  This adds a generic cpufreq driver for CPU0 frequency management.
	  It supports both uniprocessor (UP) and symmetric multiprocessor (SMP)
	  systems which share clock and voltage across all CPUs.

	  If in doubt, say N.

config CPU_FREQ_GOV_XPERIENCE
	 tristate "'xperience' cpufreq governor"
	 depends on CPU_FREQ
	 help
	'XPerience' - a "powered and smart" governor

menu "x86 CPU frequency scaling drivers"
depends on X86
source "drivers/cpufreq/Kconfig.x86"
endmenu

menu "ARM CPU frequency scaling drivers"
depends on ARM
source "drivers/cpufreq/Kconfig.arm"
endmenu

menu "PowerPC CPU frequency scaling drivers"
depends on PPC32 || PPC64
source "drivers/cpufreq/Kconfig.powerpc"
endmenu

config LAZYPLUG
	bool "Conservative hotplugging for generic devices"
	default y
	help
	  This enables the conservative hotplugging, lazyplug by arter97
	  based on intelli_plug. Refer to the comments for more info.

endif
endmenu
```
