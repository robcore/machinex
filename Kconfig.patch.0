## drivers/cpufreq/Kconfig.powerpc
```kconfig
config CPU_FREQ_MAPLE
	bool "Support for Maple 970FX Evaluation Board"
	depends on PPC_MAPLE
	help
	  This adds support for frequency switching on Maple 970FX
	  Evaluation Board and compatible boards (IBM JS2x blades).
```
