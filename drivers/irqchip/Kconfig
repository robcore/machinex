## drivers/irqchip/Kconfig
```kconfig
config IRQCHIP
config ARM_GIC
	bool
	select IRQ_DOMAIN
	select MULTI_IRQ_HANDLER

config GIC_NON_BANKED
	bool

config GIC_SECURE
	bool
	depends on ARM_GIC

config ARM_VIC
	bool
	select IRQ_DOMAIN
	select MULTI_IRQ_HANDLER

config ARM_VIC_NR
	int
	default 4 if ARCH_S5PV210
	default 3 if ARCH_S5PC100
	default 2
	depends on ARM_VIC
	help
	  The maximum number of VICs available in the system, for
	  power management.
```

## drivers/staging/vnswap/Kconfig
```kconfig
config VNSWAP
	tristate "Fake device for swap"
	depends on BLOCK && SYSFS && ZSWAP_NEW
	default n
```

## net/dsa/Kconfig
```kconfig
config HAVE_NET_DSA
	bool
	default n
	depends on NETDEVICES && !S390

# Drivers must select NET_DSA and the appropriate tagging format

config NET_DSA
	tristate
	default n
	depends on HAVE_NET_DSA
	select PHYLIB
	---help---
	  This allows you to use hardware switch chips that use
	  the Distributed Switch Architecture.


if NET_DSA

# tagging formats
config NET_DSA_TAG_DSA
	bool
	default n

config NET_DSA_TAG_EDSA
	bool
	default n

config NET_DSA_TAG_TRAILER
	bool
	default n

endif
```

## security/sdp/Kconfig
```kconfig
#
# Key management configuration
#

config sdp
	bool "Enable sdp support"
	help
	  This is a fake Kconfig description i am using
	  to test out a security feature found on better
```
